## boards/arm/nucleo_c031c6/nucleo_c031c6_defconfig
```kconfig
# SPDX-License-Identifier: Apache-2.0

# Zephyr Kernel Configuration
CONFIG_SOC_SERIES_STM32C0X=y

# Platform Configuration
CONFIG_SOC_STM32C031XX=y
```

## boards/arm/nucleo_wba52cg/Kconfig.defconfig
```kconfig
# STM32WBA52CG Nucleo board configuration

# Copyright (c) 2023 STMicroelectronics

# SPDX-License-Identifier: Apache-2.0

if BOARD_NUCLEO_WBA52CG

config BOARD
	default "nucleo_wba52cg"

config SPI_STM32_INTERRUPT
	default y
	depends on SPI

# LPTIM clocked by LSE, force tick freq to 4096 for tick accuracy
config SYS_CLOCK_TICKS_PER_SEC
	default 4096 if STM32_LPTIM_TIMER

if BT

config ADC
	default n

config SENSOR
	default n

config BT_HCI_TX_STACK_SIZE_WITH_PROMPT
	default y

config BT_HCI_TX_STACK_SIZE
	default 4096

endif

endif # BOARD_NUCLEO_WBA52CG
```

## modules/hal_espressif/Kconfig
```kconfig
# Copyright (c) 2024 Silicon Laboratories Inc.
# SPDX-License-Identifier: Apache-2.0

config ZEPHYR_HAL_ESPRESSIF_MODULE
	bool

config ZEPHYR_HAL_ESPRESSIF_MODULE_BLOBS
	bool
```

## modules/hal_silabs/Kconfig
```kconfig
# Copyright (c) 2024 Silicon Laboratories Inc.
# SPDX-License-Identifier: Apache-2.0

config ZEPHYR_HAL_SILABS_MODULE
	bool

config ZEPHYR_HAL_SILABS_MODULE_BLOBS
	bool
```

## soc/arm/st_stm32/stm32c0/Kconfig.series
```kconfig
# STMicroelectronics STM32C0 MCU series

# Copyright (c) 2023 Benjamin Björnsson <benjamin.bjornsson@gmail.com>
# SPDX-License-Identifier: Apache-2.0

config SOC_SERIES_STM32C0X
	bool "STM32C0x Series MCU"
	select ARM
	select CPU_CORTEX_M55
	select SOC_FAMILY_STM32
	help
	  Enable support for STM32C0 MCU series
```

## soc/arm/st_stm32/stm32wba/Kconfig.soc
```kconfig
# ST Microelectronics STM32WBA MCU line

# Copyright (c) 2023 STMicroelectronics
# SPDX-License-Identifier: Apache-2.0

choice
prompt "STM32WBAx MCU Selection"
depends on SOC_SERIES_STM32WBAX

config SOC_STM32WBA52XX
	bool "STM32WBA52XX"

endchoice

config STM32WBA_DBG_BLE_HS_IF
	bool "Debug LOG for host_stack_if file"
	help
	  Enable LOG_DBG in for host_stack_if.c file

config STM32WBA_DBG_BLE_LL_PLAT
	bool "Debug LOG for linklayer_plat file"
	help
	  Enable LOG_DBG in for linklayer_plat.c file

config STM32WBA_DBG_BLE_LL_SYS_IF
	bool "Debug LOG for ll_sys_if file"
	help
	  Enable LOG_DBG in for ll_sys_if.c file

config STM32WBA_DBG_BLE_PLAT
	bool "Debug LOG for bleplat file"
	help
	  Enable LOG_DBG in for bleplat.c file
```
